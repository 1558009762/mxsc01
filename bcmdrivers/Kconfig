## bcmdrivers/Kconfig
```kconfig
menu "Broadcom iProc Drivers"
	depends on ARCH_IPROC

source "../../bcmdrivers/keypad/Kconfig"
source "../../bcmdrivers/touch_screen/Kconfig"
source "../../bcmdrivers/adc/Kconfig"
source "../../bcmdrivers/rtc/Kconfig"
source "../../bcmdrivers/timer/Kconfig"
source "../../bcmdrivers/otp/Kconfig"
source "../../bcmdrivers/bbl/Kconfig"
source "../../bcmdrivers/rng/Kconfig"
source "../../bcmdrivers/mdio/Kconfig"
source "../../bcmdrivers/gsio_spi/Kconfig"
source "../../bcmdrivers/sd/Kconfig"
source "../../bcmdrivers/gpio/Kconfig"
source "../../bcmdrivers/qspi/Kconfig"
source "../../bcmdrivers/nand/Kconfig"
source "../../bcmdrivers/kdrivers/nor/Kconfig"
source "../../bcmdrivers/usb2h/Kconfig"
source "../../bcmdrivers/usb3h/Kconfig"
source "../../bcmdrivers/usbd/Kconfig"
source "../../bcmdrivers/pcie/Kconfig"
source "../../bcmdrivers/gmac/et/Kconfig"
source "../../bcmdrivers/gmac/hnd/Kconfig"
source "../../bcmdrivers/sound/Kconfig"
source "../../bcmdrivers/smbus/Kconfig"
source "../../bcmdrivers/sra/Kconfig"
source "../../bcmdrivers/pmu/Kconfig"
source "../../bcmdrivers/smartcard/Kconfig"
source "../../bcmdrivers/spl/Kconfig"
source "../../bcmdrivers/dte/Kconfig"
source "../../bcmdrivers/smc35x_lcd/Kconfig"
source "../../bcmdrivers/video/Kconfig"

config BCM_IPROC_CA9_PREFETCH
	tristate "CortexA9 cache auto-prefetching support"
	depends on ARCH_IPROC
	default n
	help
	  Enable iProc CortexA9 L1/L2 cache auto-prefetching support
	
	  If unsure, say N.

config BCM_BARRIER_PERFORMANCE
	bool "Linux memory barrier performance improvement"
	depends on ARCH_IPROC
	default n
	help
	  Enable linux memory barrier performance improvements
	
	  If unsure, say N.

config BCM_MEM_OPTIMIZATION
	bool "ARM Memory library optimization"
	depends on ARCH_IPROC
	default n
	help
	  Enable ARM memory library optimization
	
	  If unsure, say N.

config BROADCOM_CUSTOM_SENDFILE
	bool "Custom Sendfile optimization"
	depends on ARCH_IPROC
	default n
	help
	  Enable Broadcom Custom Sendfile optimization
	
	  If unsure, say N.

config BCM_CUSTOM_RECVFILE
	bool "Custom Receivefile optimization"
	depends on ARCH_IPROC
	default n
	help
	  Enable Broadcom Custom Receivefile optimization
	
	  If unsure, say N.

config BCM_CUSTOM_RECVFILE_MAX_PERF
# Enabling BCM_CUSTOM_RECVFILE_MAX_PERF gives maximum write performance 
# at the risk of filesystem errors (due to skipping cache invalidation 
# on writes) and exposure to A0 hardware errata for lazy interrupts.
	bool "Custom Receivefile Max Performance optimization"
	depends on ARCH_IPROC && BCM_CUSTOM_RECVFILE
	default n
	help
	  Enable Broadcom Custom Receivefile Maximum Performance optimization
	
	  If unsure, say N.

config BCM_GRO_ENABLE
	bool "Broadcom GRO Enable"
	depends on ARCH_IPROC && (ET_NAPI_POLL || ET_NAPI2_POLL)
	default n
	help
	  Enable Broadcom Generic Receive Offload
	
	  If unsure, say N.


### kdrivers
##  kdrivers/nor integrated at ../kernel/linux-3.6.5/drivers/mtd/Makefile
##  CFI driver required to be integrated before the bsp file builds

### hook for gpl driver master file
source "../../bcmgpldrivers/Kconfig"
### hook for partner driver master file
#source "../../bcmpartnerdrivers/Kconfig"
endmenu
```

## bcmdrivers/adc/Kconfig
```kconfig
config IPROC_ADC
	tristate "IPROC ADC driver support"
	default no
        help
          Say Y here if you want support for the ADC.
```

## bcmdrivers/bbl/Kconfig
```kconfig
config IPROC_BBL
	tristate "BBL API support"
	default n
	help
	  Cygnus BBL API support  	
	  If unsure, say N.
```

## bcmdrivers/dte/Kconfig
```kconfig
config IPROC_DTE
	tristate "IPROC DTE support"
	depends on ARCH_IPROC && IPROC_GPIO && !IPROC_MSR
	default n
	help
	  DTE support 
	
	  If unsure, say N.
```

## bcmdrivers/gmac/et/Kconfig
```kconfig
config IPROC_GMAC
	tristate "GMAC support "
	select NETDEVICES
	select PCI
	select HND
	select ET
	select ET_ALL_PASSIVE_ON
	depends on ARCH_IPROC
	default n
	help
	  Add GMAC  support
	
	  If unsure, say N.
```

## bcmdrivers/gpio/Kconfig
```kconfig
config IPROC_GPIO
	tristate "GPIO support"
	select GENERIC_GPIO
	select ARCH_REQUIRE_GPIOLIB
	select GPIOLIB
	depends on ARCH_IPROC
	default y
	help
	  Add GPIO support
	
	  If unsure, say N.
```

## bcmdrivers/gsio_spi/Kconfig
```kconfig
config IPROC_GSIO_SPI
	tristate "GSIO SPI support"
	depends on ARCH_IPROC
	select SPI
	select SPI_MASTER
	default n
	help
	  SPI support 
	
	  If unsure, say N.
```

## bcmdrivers/keypad/Kconfig
```kconfig
config IPROC_KEYPAD
	tristate "IPROC keypad driver support"
	select INPUT
	select INPUT_EVDEV
	default no
        help
          Say Y here if you want support for the keypad.
```

## bcmdrivers/mdio/Kconfig
```kconfig
config IPROC_MDIO
	tristate "MDIO support"
	select NET
	select PHYLIB
	depends on ARCH_IPROC
	default n
	help
	  MDIO support 
	
	  If unsure, say N.
```

## bcmdrivers/otp/Kconfig
```kconfig
config IPROC_OTP
	tristate "OTP support"
	depends on ARCH_IPROC
	default n
	help
	  OTP support 
	
	  If unsure, say N.

config CYGNUS_SOTP
	tristate "Cygnus SOTP support"
	default n
	help
	  Cygnus SOTP support
          If unsure, say N.

config BRCM_CE_28nm_OTP
	tristate "Broadcom CE 28nm OTP support"
	default n
	help
	  Broadcom CE 28nm OTP driver 
	
	  If unsure, say N.
```

## bcmdrivers/pcie/Kconfig
```kconfig
config IPROC_PCIE
	tristate "PCIE support"
	select PCI
	select PCI_DOMAINS
	depends on ARCH_IPROC
	default n
	help
	  Add PCIe support
	
	  If unsure, say N.
config IPROC_PCIE_AER
	tristate "PCIE AER support"
	depends on IPROC_PCIE
	default n
	help
	  Add PCIe RC AER support
```

## bcmdrivers/pmu/Kconfig
```kconfig
config IPROC_PMU
	tristate "Iproc PMU support"
	depends on ARCH_IPROC
	default y
	help
	  Iproc PMU support 
	  This config provides kernel-side support for iProc PMU description.
	  Its generic driver is perf_event.c
```

## bcmdrivers/rng/Kconfig
```kconfig
config IPROC_RNG
	tristate "RNG support"
	select HW_RANDOM
	depends on ARCH_IPROC
	default n
	help
	  RNG support 
	  This driver provides kernel-side support for a generic Random
	  Number Generator.
	
	  If unsure, say N.
```

## bcmdrivers/rtc/Kconfig
```kconfig
config IPROC_RTC
	tristate "RTC support"
	select RTC_CLASS 
	default n
	help
	  Cygnus RTC support  	
	  If unsure, say N.
```

## bcmdrivers/sd/Kconfig
```kconfig
config IPROC_SD
	tristate "SDHCI support"
	select MMC
	select MMC_SDHCI
	select MMC_SDHCI_IO_ACCESSORS
	default n
	help
	  This selects the platform Secure Digital Host Controller Interface.
	
	  If unsure, say N.
```

## bcmdrivers/smartcard/Kconfig
```kconfig
config IPROC_SMARTCARD
	tristate "IPROC SmartCard support"
	depends on ARCH_IPROC
	default n
	help
	  iProc SoCs Smart Card support.
	  This driver supports NXP8024 as coupler, also supports NXP8026 with I2C1.

	  If unsure, say N.

config IPROC_SMARTCARD_DEBUG
	bool "IPROC SmartCard debug output"
	depends on IPROC_SMARTCARD
	default n
	help
	  iProc SoCs Smart Card driver debug info output.
	  If yes, this will build debug info, to output it, also need to set module parameter debug=1

	  If unsure, say N.
```

## bcmdrivers/smbus/Kconfig
```kconfig
config IPROC_I2C
    tristate "I2C support"
    depends on ARCH_IPROC
    default n
    help
      I2C support

      If unsure, say N.
```

## bcmdrivers/smc35x_lcd/Kconfig
```kconfig
config SMC35X_LCD
	tristate "IPROC smc35x lcd test driver support"
	default no
        help
          Say Y here if you want support for the smc35x lcd sram driver.
```

## bcmdrivers/sound/Kconfig
```kconfig
# Helper to resolve issues with configs that have SPI enabled but I2C
# modular, meaning we can't build the codec driver in with I2C support.
# We use an ordered list of conditional defaults to pick the appropriate
# setting - SPI can't be modular so that case doesn't need to be covered.

config IPROC_SND
	tristate "Sound/I2S support"
	depends on ARCH_IPROC && IPROC_GSIO_SPI
	default n
	help
	  Sound I2S support 
	  This driver provides kernel-side support for a sound and I2S
	  Number Generator.
	
	  If unsure, say N.

config SND_BCM5830X_SOC
	tristate
	depends on ARCH_IPROC
	help
	  Say Y or M if you want to add audio support for CYGNUS

	  If unsure, say N.

config SND_BCM5830X_SOC_I2S
	tristate

config SND_BCM5830X_SVK
	tristate "BCM5830X SVK Audio Support"
	depends on ARCH_IPROC && IPROC_I2C && SOUND && SND_SOC && !IPROC_DTE
	default n
	select SND_BCM5830X_SOC
	select SND_BCM5830X_SOC_I2S
	select SND_SOC_TLV320AIC3X
	select SND_SOC_WM8750
	select SND_SOC_SPDIF
	help
	  Sound I2S support on BCM5830X SVK
	
	  If unsure, say N.
```

## bcmdrivers/spl/Kconfig
```kconfig
config IPROC_SPL
	tristate "IPROC SPL support"
	depends on ARCH_IPROC
	default n
	help
	  iProc SoCs secure protection logic support.
	  This driver supports the core functions of SPL:
	  watchdog timers, reset monitors, frequency monitors.

	  If unsure, say N.

config IPROC_SPL_DEBUG
	bool "IPROC SPL debug output"
	depends on IPROC_SPL
	default n
	help
	  iProc SoCs SPL driver debug info output.
	  If yes, this will build debug info.
	  To output these info, set module parameter debug=1.

	  If unsure, say N.
```

## bcmdrivers/sra/Kconfig
```kconfig
config IPROC_SRA
	tristate "Switch register access support"
	default n
	help
	  This selects the switch register access and initialize the switch.
	
	  If unsure, say N.
```

## bcmdrivers/timer/Kconfig
```kconfig
config IPROC_CCB_TIMER
	tristate "ChipcommonB Timer support"
	depends on ARCH_IPROC
	help
	  This selects a driver for the ChipcommonB SP804 Timer on Broadcom
	  iProc chips.
```

## bcmdrivers/touch_screen/Kconfig
```kconfig
config IPROC_TOUCHSCREEN
	tristate "IPROC touch panel driver support"
	default no
	select INPUT
	select INPUT_EVDEV
        help
          Say Y here if you want support for the touch panel.
```

## bcmdrivers/usb2h/Kconfig
```kconfig
config IPROC_USB2H
	tristate "USB 2.0 Host support"
	select USB_EHCI_BCM
	select USB_OHCI_BCM 
## this is for core/message.c:     err = utf16s_to_utf8s
	depends on ARCH_IPROC
	default n
	help
	  Add USB 2.0 Host support
	
	  If unsure, say N.

config USB_EHCI_BCM
        bool "Support for Broadcom on-chip EHCI USB controller"
        depends on USB_EHCI_HCD && ARCH_IPROC && IPROC_USB2H
        select USB_EHCI_ROOT_HUB_TT
        ---help---
          Enables EHCI support for USB host controller on some Broadcom
          SOCs.

config USB_OHCI_BCM
        bool "Support for Broadcom on-chip OHCI USB controller"
        depends on USB_OHCI_HCD && ARCH_IPROC && IPROC_USB2H
        ---help---
          Enables OHCI support for USB host controller on some Broadcom
          SOCs.
```

## bcmdrivers/usb3h/Kconfig
```kconfig
config IPROC_USB3H
	tristate "USB3 BCM xHC support"
	select USB_ARCH_HAS_XHCI
	depends on ARCH_IPROC
	default n
	help
	  Add USB3H support
	
	  If unsure, say N.
```
