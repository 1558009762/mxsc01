## bcmdrivers/usbd/Kconfig
```kconfig
config IPROC_USB2D
	tristate "USB 2.0 Device"
	select USB_GADGET_DUALSPEED
	depends on ARCH_IPROC && USB_GADGET && (MACH_HX4 || MACH_KT2 || MACH_GH || MACH_HR3|| MACH_SB2)
	default n
	help
	  Add USB 2.0 Device support
	
	  If unsure, say N.
```

## bcmdrivers/video/Kconfig
```kconfig
menuconfig IPROC_VIDEO
	tristate "IPROC video driver support"
	default n
        help
          Say Y here if you want support for the Camera driver.
```

## bcmgpldrivers/Kconfig
```kconfig
menu "Broadcom iProc GPL Drivers"
	depends on ARCH_IPROC

source "../../bcmgpldrivers/sound/codecs/wm8955/Kconfig"
source "../../bcmgpldrivers/sound/codecs/wm8750/Kconfig"
source "../../bcmgpldrivers/watchdog/Kconfig"
source "../../bcmgpldrivers/d1w/Kconfig"
source "../../bcmgpldrivers/spi/Kconfig"
source "../../bcmgpldrivers/msr/Kconfig"
source "../../bcmgpldrivers/dma/Kconfig"
source "../../bcmgpldrivers/video/Kconfig"

endmenu
```

## bcmgpldrivers/d1w/Kconfig
```kconfig
menuconfig IPROC_DS1WM
	tristate "IPROC 1-wire driver support"
	select W1
	default no
        help
          Say Y here if you want support for the 1-wire.

if IPROC_DS1WM
source "../../bcmgpldrivers/d1w/slave/Kconfig"
endif
```

## bcmgpldrivers/d1w/slave/Kconfig
```kconfig
menu "IPROC 1-wire slave"
config W1_SLAVE_DS2438
        tristate "Smart Battery Monitor (DS2438)"
        depends on IPROC_DS1WM
        help
          Say Y here if you want to use a 1-wire
          Smart Battery Monitor family device (DS2438).

endmenu
```

## bcmgpldrivers/dma/Kconfig
```kconfig
menuconfig IPROC_PL330_DMA
	tristate "IPROC DMA API Driver for PL330"
	select DMA_ENGINE
	depends on ARM_AMBA
	default y 
	help
	  Select if your platform has one or more PL330 DMACs.
	  You need to provide platform specific settings via
	  platform_data for a dma-pl330 device.
```

## bcmgpldrivers/msr/Kconfig
```kconfig
config IPROC_MSR
	tristate "IPROC MSR driver support"
	default M
        help
          Say Y here if you want support for the SPI MSR.
```

## bcmgpldrivers/sound/codecs/wm8955/Kconfig
```kconfig
# Helper to resolve issues with configs that have SPI enabled but I2C
# modular, meaning we can't build the codec driver in with I2C support.
# We use an ordered list of conditional defaults to pick the appropriate
# setting - SPI can't be modular so that case doesn't need to be covered.

config IPROC_SND_CODEC_WM8955
	tristate "Support sound codec wm8955"
	depends on ARCH_IPROC && IPROC_GSIO_SPI
	default m
```

## bcmgpldrivers/spi/Kconfig
```kconfig
menuconfig IPROC_SPI
	tristate "IPROC SPI driver support"
	default m 
        select SPI
        select SPI_MASTER
        help
          Say Y here if you want support for the SPI.
```

## bcmgpldrivers/video/Kconfig
```kconfig
menuconfig IPROC_OV5640
	tristate "IPROC OV5640 driver support"
	default n
        help
          Say Y here if you want support for the OV5640 driver.
```

## bcmgpldrivers/watchdog/Kconfig
```kconfig
config IPROC_CCB_WDT
	tristate "CCB Watchdog Timer support"
	select WATCHDOG
	select WATCHDOG_CORE
	select IPROC_SP805_WDT
	select BRCM_PLATFORM_SP805_WDT
	depends on ARCH_IPROC && (MACH_HR2 || MACH_HX4 || MACH_KT2)
	help
	  This selects a driver for the hardware watchdog on Broadcom
	  iProc chips.

config IPROC_CCG_WDT
	tristate "CCG Watchdog Timer support"
	select WATCHDOG
	select WATCHDOG_CORE
	select IPROC_SP805_WDT
	select BRCM_PLATFORM_SP805_WDT
	depends on ARCH_IPROC && MACH_IPROC_P7
	help
	  This selects a driver for the hardware watchdog on Broadcom
	  iProc chips.

config IPROC_SP805_WDT
	tristate

config BRCM_PLATFORM_SP805_WDT
	tristate
```

## bootloader/u-boot-2016.01/board/broadcom/bcmgh/Kconfig
```kconfig
if TARGET_BCMGH

config SYS_BOARD
	default "bcmgh"

config SYS_VENDOR
	default "broadcom"

config SYS_SOC
	default "bcmgh"

config SYS_CONFIG_NAME
	default "bcm_greyhound"

endif
```

## bootloader/u-boot-2016.01/board/broadcom/bcmhr2/Kconfig
```kconfig
if TARGET_BCMHR2

config SYS_BOARD
	default "bcmhr2"

config SYS_VENDOR
	default "broadcom"

config SYS_SOC
	default "bcmhr2"

config SYS_CONFIG_NAME
	default "bcm_hurricane2"

endif
```

## bootloader/u-boot-2016.01/board/broadcom/bcmhr3/Kconfig
```kconfig
if TARGET_BCMHR3

config SYS_BOARD
	default "bcmhr3"

config SYS_VENDOR
	default "broadcom"

config SYS_SOC
	default "bcmhr3"

config SYS_CONFIG_NAME
	default "bcm_hurricane3"

endif
```

## bootloader/u-boot-2016.01/board/broadcom/bcmhx4/Kconfig
```kconfig
if TARGET_BCMHX4

config SYS_BOARD
	default "bcmhx4"

config SYS_VENDOR
	default "broadcom"

config SYS_SOC
	default "bcmhx4"

config SYS_CONFIG_NAME
	default "bcm_helix4"

endif
```

## bootloader/u-boot-2016.01/board/broadcom/bcmsb2/Kconfig
```kconfig
if TARGET_BCMSB2

config SYS_BOARD
	default "bcmsb2"

config SYS_VENDOR
	default "broadcom"

config SYS_SOC
	default "bcmsb2"

config SYS_CONFIG_NAME
	default "bcm_saber2"

endif
```

## bootloader/u-boot-2016.01/configs/bcm956260k_be_defconfig
```kconfig
CONFIG_ARM=y
CONFIG_TARGET_BCMSB2=y
CONFIG_LOCALVERSION="'-Broadcom XLDK-3.8.1'"
CONFIG_SYS_EXTRA_OPTIONS="L2C_AS_RAM,DDR32,SYS_BIG_ENDIAN"
# CONFIG_CMD_IMLS is not set
# CONFIG_CMD_FLASH is not set
# CONFIG_CMD_SETEXPR is not set
CONFIG_SYS_NS16550=y
CONFIG_SYS_PROMPT="u-boot> "
```

## bootloader/u-boot-2016.01/configs/bcm956260k_nand_spl_defconfig
```kconfig
CONFIG_ARM=y
CONFIG_TARGET_BCMSB2=y
CONFIG_LOCALVERSION="'-Broadcom XLDK-3.8.1'"
CONFIG_SPL=y
CONFIG_SYS_EXTRA_OPTIONS="L2C_AS_RAM,DDR32,NAND_IPROC_BOOT"
# CONFIG_CMD_IMLS is not set
# CONFIG_CMD_FLASH is not set
# CONFIG_CMD_SETEXPR is not set
CONFIG_SYS_NS16550=y
CONFIG_SYS_PROMPT="u-boot> "
```

## buildroot/configs/brcm_hurricane3-uboot-lite_defconfig
```kconfig
BR2_arm=y
BR2_cortex_a9=y
BR2_PRIMARY_SITE="git.rtp.broadcom.com/dl"
BR2_BACKUP_SITE="http://sources.buildroot.net/"
BR2_KERNEL_MIRROR="http://www.kernel.org/pub/"
BR2_PACKAGE_OVERRIDE_FILE="$(TOPDIR)/local.mk"
BR2_TOOLCHAIN_EXTERNAL=y
BR2_TOOLCHAIN_EXTERNAL_CUSTOM=y
BR2_TOOLCHAIN_EXTERNAL_PATH="$(TOPDIR)/host/usr"
BR2_TOOLCHAIN_EXTERNAL_GCC_4_9=y
BR2_TOOLCHAIN_EXTERNAL_HEADERS_4_4=y
BR2_TOOLCHAIN_EXTERNAL_WCHAR=y
BR2_TOOLCHAIN_EXTERNAL_INET_RPC=y
BR2_TOOLCHAIN_EXTERNAL_CXX=y
BR2_TARGET_OPTIMIZATION="-pipe"
BR2_TARGET_GENERIC_HOSTNAME="iProc"
BR2_TARGET_GENERIC_ISSUE="Welcome to Broadcom Linux"
BR2_INIT_NONE=y
BR2_ROOTFS_DEVICE_CREATION_STATIC=y
BR2_ROOTFS_SKELETON_CUSTOM=y
BR2_ROOTFS_SKELETON_CUSTOM_PATH="board/broadcom/iproc/skeleton"
# BR2_PACKAGE_BUSYBOX is not set
# BR2_TARGET_ROOTFS_TAR is not set
BR2_TARGET_UBOOT=y
BR2_TARGET_UBOOT_BUILD_SYSTEM_KCONFIG=y
BR2_TARGET_UBOOT_CUSTOM_LOCAL=y
BR2_TARGET_UBOOT_CUSTOM_LOCAL_PATH="../bootloader/u-boot-2016.01"
BR2_TARGET_UBOOT_BOARD_DEFCONFIG="bcm956164k"
```
