## buildroot/configs/brcm_iproc-gh-flash-ncustfs_defconfig
```kconfig
BR2_arm=y
BR2_cortex_a9=y
BR2_PRIMARY_SITE="git.rtp.broadcom.com/dl"
BR2_BACKUP_SITE="http://sources.buildroot.net/"
BR2_KERNEL_MIRROR="http://www.kernel.org/pub/"
BR2_DEPRECATED=y
BR2_SHARED_STATIC_LIBS=y
BR2_PACKAGE_OVERRIDE_FILE="$(TOPDIR)/local.mk"
BR2_TOOLCHAIN_EXTERNAL=y
BR2_TOOLCHAIN_EXTERNAL_CUSTOM=y
BR2_TOOLCHAIN_EXTERNAL_PATH="$(TOPDIR)/host/usr"
BR2_TOOLCHAIN_EXTERNAL_GCC_4_9=y
BR2_TOOLCHAIN_EXTERNAL_HEADERS_4_4=y
BR2_TOOLCHAIN_EXTERNAL_WCHAR=y
BR2_TOOLCHAIN_EXTERNAL_INET_RPC=y
BR2_TOOLCHAIN_EXTERNAL_CXX=y
BR2_TARGET_OPTIMIZATION="-pipe"
BR2_TARGET_GENERIC_HOSTNAME="iProc"
BR2_TARGET_GENERIC_ISSUE="Welcome to Broadcom Linux"
BR2_INIT_NONE=y
BR2_ROOTFS_SKELETON_CUSTOM=y
BR2_ROOTFS_SKELETON_CUSTOM_PATH="board/broadcom/iproc/skeleton"
BR2_ROOTFS_POST_IMAGE_SCRIPT="fs/ncustfs/post_image.sh"
BR2_ROOTFS_POST_SCRIPT_ARGS="$(BINARIES_DIR)"
# BR2_PACKAGE_BUSYBOX is not set
# BR2_TARGET_ROOTFS_TAR is not set
BR2_TARGET_ROOTFS_NCUSTFS=y
BR2_TARGET_ROOTFS_NCUSTFS_DIR="./board/broadcom/iproc/ncustfs"
BR2_TARGET_ROOTFS_NCUSTFS_LEBSIZE=0x3e000
BR2_TARGET_ROOTFS_NCUSTFS_MINIOSIZE=0x1000
BR2_TARGET_ROOTFS_NCUSTFS_MAXLEBCNT=4096
BR2_TARGET_ROOTFS_NCUSTFS_RT_NONE=y
BR2_TARGET_ROOTFS_NCUST=y
BR2_TARGET_ROOTFS_NCUST_PEBSIZE=0x40000
BR2_TARGET_ROOTFS_NCUST_SUBSIZE=0
```

## buildroot/configs/brcm_iproc-glibc-tools_defconfig
```kconfig
BR2_arm=y
BR2_cortex_a9=y
BR2_HOST_DIR="$(TOPDIR)/host"
BR2_PRIMARY_SITE="git.rtp.broadcom.com/dl"
BR2_BACKUP_SITE="http://sources.buildroot.net/"
BR2_KERNEL_MIRROR="http://www.kernel.org/pub/"
BR2_CCACHE=y
BR2_SHARED_STATIC_LIBS=y
BR2_PACKAGE_OVERRIDE_FILE="$(TOPDIR)/local.mk"
BR2_TOOLCHAIN_BUILDROOT_VENDOR="broadcom"
BR2_KERNEL_HEADERS_4_4=y
BR2_TOOLCHAIN_BUILDROOT_GLIBC=y
BR2_GLIBC_VERSION_2_22=y
BR2_TOOLCHAIN_BUILDROOT_CXX=y
BR2_GCC_ENABLE_LTO=y
BR2_GCC_ENABLE_OPENMP=y
BR2_GCC_ENABLE_GRAPHITE=y
BR2_PACKAGE_HOST_GDB=y
BR2_TARGET_OPTIMIZATION="-pipe"
BR2_TARGET_GENERIC_HOSTNAME="iProc"
BR2_TARGET_GENERIC_ISSUE="Welcome to Broadcom Linux"
BR2_INIT_NONE=y
BR2_ROOTFS_SKELETON_CUSTOM=y
BR2_ROOTFS_SKELETON_CUSTOM_PATH="board/broadcom/iproc/skeleton"
# BR2_PACKAGE_BUSYBOX is not set
BR2_PACKAGE_MAKE=y
# BR2_TARGET_ROOTFS_TAR is not set
BR2_PACKAGE_HOST_MTD=y
BR2_PACKAGE_HOST_MTOOLS=y
BR2_PACKAGE_HOST_UBOOT_TOOLS=y
```

## buildroot/configs/brcm_iproc-nfs-rootfs_defconfig
```kconfig
BR2_arm=y
BR2_cortex_a9=y
BR2_PRIMARY_SITE="git.rtp.broadcom.com/dl"
BR2_BACKUP_SITE="http://sources.buildroot.net/"
BR2_KERNEL_MIRROR="http://www.kernel.org/pub/"
BR2_JLEVEL=4
BR2_DEPRECATED=y
BR2_SHARED_STATIC_LIBS=y
BR2_PACKAGE_OVERRIDE_FILE="$(TOPDIR)/local.mk"
BR2_TOOLCHAIN_EXTERNAL=y
BR2_TOOLCHAIN_EXTERNAL_CUSTOM=y
BR2_TOOLCHAIN_EXTERNAL_PATH="$(TOPDIR)/host/usr"
BR2_TOOLCHAIN_EXTERNAL_GCC_4_9=y
BR2_TOOLCHAIN_EXTERNAL_HEADERS_4_4=y
BR2_TOOLCHAIN_EXTERNAL_WCHAR=y
BR2_TOOLCHAIN_EXTERNAL_INET_RPC=y
BR2_TOOLCHAIN_EXTERNAL_CXX=y
BR2_PACKAGE_HOST_GDB=y
BR2_TARGET_OPTIMIZATION="-pipe"
BR2_TARGET_GENERIC_HOSTNAME="iProc"
BR2_TARGET_GENERIC_ISSUE="Welcome to Broadcom Linux"
BR2_INIT_NONE=y
BR2_ROOTFS_DEVICE_CREATION_DYNAMIC_EUDEV=y
BR2_ROOTFS_SKELETON_CUSTOM=y
BR2_ROOTFS_SKELETON_CUSTOM_PATH="board/broadcom/iproc/skeleton"
BR2_PACKAGE_BUSYBOX_CONFIG="board/broadcom/iproc/busybox.config"
BR2_PACKAGE_BUSYBOX_SHOW_OTHERS=y
BR2_PACKAGE_BZIP2=y
BR2_PACKAGE_GZIP=y
BR2_PACKAGE_GDB=y
BR2_PACKAGE_GDB_SERVER=y
BR2_PACKAGE_GDB_DEBUGGER=y
BR2_PACKAGE_GDB_TUI=y
BR2_PACKAGE_STRACE=y
BR2_PACKAGE_VALGRIND=y
BR2_PACKAGE_BINUTILS=y
BR2_PACKAGE_BINUTILS_TARGET=y
BR2_PACKAGE_FINDUTILS=y
BR2_PACKAGE_MAKE=y
BR2_PACKAGE_SED=y
BR2_PACKAGE_MTD=y
BR2_PACKAGE_MTD_MKFSJFFS2=y
BR2_PACKAGE_MTOOLS=y
BR2_PACKAGE_NFS_UTILS=y
BR2_PACKAGE_PCIUTILS=y
BR2_PACKAGE_USB_MODESWITCH_DATA=y
BR2_PACKAGE_USBUTILS=y
BR2_PACKAGE_OPENSSL=y
BR2_PACKAGE_LIBFUSE=y
BR2_PACKAGE_ELFUTILS=y
BR2_PACKAGE_LIBGLIB2=y
BR2_PACKAGE_NCURSES_TARGET_PANEL=y
BR2_PACKAGE_NCURSES_TARGET_FORM=y
BR2_PACKAGE_NCURSES_TARGET_MENU=y
BR2_PACKAGE_ETHTOOL=y
BR2_PACKAGE_IPTABLES=y
BR2_PACKAGE_NCFTP=y
BR2_PACKAGE_FILE=y
BR2_PACKAGE_SYSKLOGD=y
BR2_PACKAGE_UTIL_LINUX_BINARIES=y
```

## buildroot/configs/brcm_saber2-flash_defconfig
```kconfig
BR2_arm=y
BR2_cortex_a9=y
BR2_PRIMARY_SITE="git.rtp.broadcom.com/dl"
BR2_BACKUP_SITE="http://sources.buildroot.net/"
BR2_KERNEL_MIRROR="http://www.kernel.org/pub/"
BR2_JLEVEL=4
BR2_DEPRECATED=y
BR2_SHARED_STATIC_LIBS=y
BR2_PACKAGE_OVERRIDE_FILE="$(TOPDIR)/local.mk"
BR2_TOOLCHAIN_EXTERNAL=y
BR2_TOOLCHAIN_EXTERNAL_CUSTOM=y
BR2_TOOLCHAIN_EXTERNAL_PATH="$(TOPDIR)/host/usr"
BR2_TOOLCHAIN_EXTERNAL_GCC_4_9=y
BR2_TOOLCHAIN_EXTERNAL_HEADERS_4_4=y
BR2_TOOLCHAIN_EXTERNAL_WCHAR=y
BR2_TOOLCHAIN_EXTERNAL_INET_RPC=y
BR2_TOOLCHAIN_EXTERNAL_CXX=y
BR2_PACKAGE_HOST_GDB=y
BR2_TARGET_OPTIMIZATION="-pipe"
BR2_TARGET_GENERIC_HOSTNAME="iProc"
BR2_TARGET_GENERIC_ISSUE="Welcome to Broadcom Linux"
BR2_INIT_NONE=y
BR2_ROOTFS_DEVICE_CREATION_DYNAMIC_EUDEV=y
BR2_ROOTFS_SKELETON_CUSTOM=y
BR2_ROOTFS_SKELETON_CUSTOM_PATH="board/broadcom/iproc/skeleton"
BR2_ROOTFS_POST_IMAGE_SCRIPT="board/broadcom/iproc/post_image.sh"
BR2_ROOTFS_POST_SCRIPT_ARGS="saber2"
BR2_LINUX_KERNEL=y
BR2_LINUX_KERNEL_CUSTOM_LOCAL=y
BR2_LINUX_KERNEL_CUSTOM_LOCAL_PATH="../kernel/linux-4.4"
BR2_LINUX_KERNEL_USE_CUSTOM_CONFIG=y
BR2_LINUX_KERNEL_CUSTOM_CONFIG_FILE="board/broadcom/saber2/linux-4.4-flash.config"
BR2_LINUX_KERNEL_IMAGE_TARGET_CUSTOM=y
BR2_LINUX_KERNEL_IMAGE_TARGET_NAME="Image"
BR2_LINUX_KERNEL_DTS_SUPPORT=y
BR2_LINUX_KERNEL_INTREE_DTS_NAME="bcm956260"
BR2_PACKAGE_BUSYBOX_CONFIG="board/broadcom/iproc/busybox.config"
BR2_PACKAGE_BUSYBOX_SHOW_OTHERS=y
BR2_PACKAGE_BZIP2=y
BR2_PACKAGE_GZIP=y
BR2_PACKAGE_STRACE=y
BR2_PACKAGE_MAKE=y
BR2_PACKAGE_SED=y
BR2_PACKAGE_MTD=y
BR2_PACKAGE_MTD_MKFSJFFS2=y
BR2_PACKAGE_PCIUTILS=y
BR2_PACKAGE_USBUTILS=y
BR2_PACKAGE_ELFUTILS=y
BR2_PACKAGE_NCURSES=y
BR2_PACKAGE_NCURSES_TARGET_PANEL=y
BR2_PACKAGE_NCURSES_TARGET_FORM=y
BR2_PACKAGE_NCURSES_TARGET_MENU=y
BR2_PACKAGE_ETHTOOL=y
BR2_PACKAGE_IPTABLES=y
BR2_PACKAGE_NCFTP=y
BR2_PACKAGE_SYSKLOGD=y
BR2_PACKAGE_UTIL_LINUX_BINARIES=y
BR2_TARGET_ROOTFS_JFFS2=y
BR2_TARGET_ROOTFS_JFFS2_FLASH_64=y
# BR2_TARGET_ROOTFS_TAR is not set
BR2_TARGET_ROOTFS_UBIFS=y
BR2_TARGET_ROOTFS_UBIFS_LEBSIZE=0xfe000
BR2_TARGET_ROOTFS_UBIFS_MINIOSIZE=0x1000
BR2_TARGET_ROOTFS_UBIFS_RT_NONE=y
BR2_TARGET_ROOTFS_UBI=y
BR2_TARGET_ROOTFS_UBI_PEBSIZE=0x100000
BR2_TARGET_ROOTFS_UBI_SUBSIZE=0
```

## kernel/linux-3.6.5/arch/arm/mach-iproc/Kconfig
```kconfig
menu	"iProc SoC based Machine types"
	depends on MACH_IPROC

choice
	prompt "iProc SoC based board type"
	default MACH_HX4	

config MACH_HX4
	bool "Support Broadcom Helix4 bring-up board"
	help
	  Support for the Broadcom Helix4 bring-up board.

config MACH_HR2
	bool "Support Broadcom Hurricane2 bring-up board"
	help
	  Support for the Broadcom Hurricane2 bring-up board.

config MACH_KT2
	bool "Support Broadcom Katana2 bring-up board"
	help
	  Support for the Broadcom Katana2 bring-up board.

config MACH_GH
	bool "Support Broadcom Greyhound bring-up board"
	select MACH_IPROC_P7
	help
	  Support for the Broadcom Greyhound bring-up board.

config MACH_SB2
	bool "Support Broadcom Saber2 bring-up board"
	select MACH_IPROC_P7
	help
	  Support for the Broadcom Saber2 bring-up board.

config MACH_HR3
	bool "Support Broadcom Hurricane3 bring-up board"
	select MACH_IPROC_P7
	help
	  Support for the Broadcom Hurricane3 bring-up board.

endchoice

config MACH_IPROC_P7
	bool "Support iProc Profile 7 architecture"
	depends on (MACH_GH || MACH_SB2 || MACH_HR3)
	help
	  Support for iProc Profile 7 architecture.

config MACH_IPROC_EMULATION
	bool "Support  iProc emulation"
	help
	  Support for the iProc emulation.

endmenu
```

## kernel/linux-4.4/Documentation/devicetree/bindings/pci/iproc-pcie.txt
```
* Broadcom iProc PCIe controller

Required properties:
- compatible: set to "brcm,iproc-pcie"
- reg: base address and length of the PCIe controller
- interrupts: interrupt ID
- #address-cells: set to <3>
- #size-cells: set to <2>
- device_type: set to "pci"
- ranges: ranges for the PCI memory and I/O regions

Optional properties:
- phy-addr: PCIe PHY addr for MDIO access
- bus-range: PCI bus numbers covered

The Broadcom iProc PCie driver adapts the multi-domain structure, i.e., each
interface has its own domain and therefore has its own device node

Example:

	pcie0: pcie@18012000 {
		compatible = "brcm,iproc-pcie", "iproc-p2";
		reg = <0x18012000 0x1000>;
		irqs-total = <6>; /*total irqs used*/
		interrupts = <0 182 0>,
			     <0 183 0>,
			     <0 184 0>,
			     <0 185 0>,
			     <0 186 0>,
			     <0 187 0>;
		#address-cells = <3>;
		#size-cells = <2>;
		device_type = "pci";
		/*non-prefetchable mem space, pcie addr 0x0 0x08000000, cpu addr 0x08000000, size 0x0 0x08000000*/  		
		ranges = <0x82000000 0 0x08000000 0x08000000 0 0x08000000>;	
		phy-addr = <0>;
	};
```

## kernel/linux-4.4/Documentation/devicetree/bindings/spi/iproc-qspi.txt
```
BROADCOM iProc QSPI controller

Required properties:
- compatible: "bcm,qspi_iproc";
- reg: Offset and length of the register set including 
		mspi_hw: Master SPI
		bspi_hw: Boot SPI
		bspi_hw_raf: Boot SPI read ahead fifo
		qspi_intr: QSPI interrupt related
		idm_qspi:QSPI IDM related
		cru_hw: QSPI CRU related
- interrupts: interrupt id of the QSPI controller		
- clocks: clock source

Optional properties:
- #chip-select: Specify the used chip select for controller with multi chip selects
- flash: the used serial flash


Example:

	qspi: spi@0x18027200 {
		#address-cells = <1>;
		#size-cells = <1>;
		compatible = "bcm,qspi_iproc";
		reg = mspi_hw:<0x18027200 0x188>,
		      bspi_hw:<0x18027000 0x050>,
		  bspi_hw_raf:<0x18027100 0x024>,
		    qspi_intr:<0x180273a0 0x01c>,
		     idm_qspi:<0x1811c408 0x004>,
		       cru_hw:<0x1803e000 0x004>;
		interrupts = <0 78 4>, <0 84 4>; /*irq_min, irq_max*/
		#chip-select = <0>; 
		clocks = <&apb_clk>;
		clock-names = "apb_clk";
		flash: m25p80@0 {
			#address-cells = <1>;
			#size-cells = <1>;
			compatible = "m25p80";
			spi-max-frequency = <62500000>;
			reg = <0x0 0x0>;
			partition@0 {
				label = "boot";
				reg = <0x00000000 0x000a0000>;
				/*read-only;*/
			};
			partition@1 {
				label = "env";
				reg = <0x000a0000 0x00060000>;
			};
			partition@2 {
				label = "system";
				reg = <0x00100000 0x00f00000>;
			};
			partition@3 {
				label = "rootfs";
				reg = <0x01000000 0x01000000>;
			};
		};
	};
```

## kernel/linux-4.4/arch/arm/mach-iproc/Kconfig
```kconfig
#
# Copyright (C) 2013, Broadcom Corporation. All Rights Reserved.
# 
# Permission to use, copy, modify, and/or distribute this software for any
# purpose with or without fee is hereby granted, provided that the above
# copyright notice and this permission notice appear in all copies.
# 
# THE SOFTWARE IS PROVIDED "AS IS" AND THE AUTHOR DISCLAIMS ALL WARRANTIES
# WITH REGARD TO THIS SOFTWARE INCLUDING ALL IMPLIED WARRANTIES OF
# MERCHANTABILITY AND FITNESS. IN NO EVENT SHALL THE AUTHOR BE LIABLE FOR ANY
# SPECIAL, DIRECT, INDIRECT, OR CONSEQUENTIAL DAMAGES OR ANY DAMAGES
# WHATSOEVER RESULTING FROM LOSS OF USE, DATA OR PROFITS, WHETHER IN AN ACTION
# OF CONTRACT, NEGLIGENCE OR OTHER TORTIOUS ACTION, ARISING OUT OF OR IN
# CONNECTION WITH THE USE OR PERFORMANCE OF THIS SOFTWARE.
#
menu	"iProc SoC based Machine types"
	depends on ARCH_IPROC

choice
	prompt "iProc SoC based board type"
	default MACH_HX4	

config MACH_HX4
	bool "Support Broadcom Helix4 bring-up board"
	help
	  Support for the Broadcom Helix4 bring-up board.

config MACH_HR2
	bool "Support Broadcom Hurricane2 bring-up board"
	help
	  Support for the Broadcom Hurricane2 bring-up board.

config MACH_KT2
	bool "Support Broadcom Katana2 bring-up board"
	help
	  Support for the Broadcom Katana2 bring-up board.

config MACH_GH
	bool "Support Broadcom Greyhound bring-up board"
	select MACH_IPROC_P7
	help
	  Support for the Broadcom Greyhound bring-up board.

config MACH_SB2
	bool "Support Broadcom Saber2 bring-up board"
	select MACH_IPROC_P7
	help
	  Support for the Broadcom Saber2 bring-up board.

config MACH_HR3
	bool "Support Broadcom Hurricane3 bring-up board"
	select MACH_IPROC_P7
	help
	  Support for the Broadcom Hurricane3 bring-up board.

config MACH_GH2
       bool "Support Broadcom Greyhound2 bring-up board"
       select MACH_IPROC_P7
       help
         Support for the Broadcom Greyhound2 bring-up board.



endchoice

config MACH_IPROC_P7
	bool "Support iProc Profile 7 architecture"
	depends on (MACH_GH || MACH_SB2 || MACH_HR3)
	help
	  Support for iProc Profile 7 architecture.

config MACH_IPROC_EMULATION
	bool "Support  iProc emulation"
	help
	  Support for the iProc emulation.

endmenu
```

## kernel/linux-4.4/drivers/clk/bcm/Kconfig
```kconfig
config CLK_BCM_KONA
	bool "Broadcom Kona CCU clock support"
	depends on ARCH_BCM_MOBILE || COMPILE_TEST
	depends on COMMON_CLK
	default y
	help
	  Enable common clock framework support for Broadcom SoCs
	  using "Kona" style clock control units, including those
	  in the BCM281xx and BCM21664 families.

config COMMON_CLK_IPROC
	bool
	depends on COMMON_CLK
	help
	  Enable common clock framework support for Broadcom SoCs
	  based on the iProc architecture

config COMMON_CLK_XGS_IPROC
	bool "BRCM XGS iProc clock support"
	depends on COMMON_CLK && ARCH_IPROC
	default ARCH_IPROC
	help
	  Enable common clock framework support for Broadcom SoCs
	  based on the iProc architecture
	  
	  
```
