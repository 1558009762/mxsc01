## kernel/linux-4.4/drivers/mtd/spi-nor/Kconfig
```kconfig
menuconfig MTD_SPI_NOR
	tristate "SPI-NOR device support"
	depends on MTD
	help
	  This is the framework for the SPI NOR which can be used by the SPI
	  device drivers and the SPI-NOR device driver.

if MTD_SPI_NOR

config MTD_SPI_NOR_USE_4K_SECTORS
	bool "Use small 4096 B erase sectors"
	default y
	help
	  Many flash memories support erasing small (4096 B) sectors. Depending
	  on the usage this feature may provide performance gain in comparison
	  to erasing whole blocks (32/64 KiB).
	  Changing a small part of the flash's contents is usually faster with
	  small sectors. On the other hand erasing should be faster when using
	  64 KiB block instead of 16 × 4 KiB sectors.

	  Please note that some tools/drivers/filesystems may not work with
	  4096 B erase size (e.g. UBIFS requires 15 KiB as a minimum).

config SPI_FSL_QUADSPI
	tristate "Freescale Quad SPI controller"
	depends on ARCH_MXC || COMPILE_TEST
	depends on HAS_IOMEM
	help
	  This enables support for the Quad SPI controller in master mode.
	  This controller does not support generic SPI. It only supports
	  SPI NOR.

config SPI_NXP_SPIFI
	tristate "NXP SPI Flash Interface (SPIFI)"
	depends on OF && (ARCH_LPC18XX || COMPILE_TEST)
	depends on HAS_IOMEM
	help
	  Enable support for the NXP LPC SPI Flash Interface controller.

	  SPIFI is a specialized controller for connecting serial SPI
	  Flash. Enable this option if you have a device with a SPIFI
	  controller and want to access the Flash as a mtd device.

endif # MTD_SPI_NOR


menuconfig MTD_SPI_NOR_IPROC
	tristate "BRCM IPROC SPI-NOR device support"
	depends on MTD
	help
	  This is the framework for the SPI NOR which can be used by the SPI
	  device drivers and the SPI-NOR device driver.

if MTD_SPI_NOR_IPROC

config M25PXX_STAY_IN_3BYTE_MODE
	bool "Stay in 3-byte address mode when idle"
	default n
	help
	  This option forces the flash to stay in 3-byte address mode when idle 
	  (even for flashes that require 4-byte address). This is work around the
	  reset problem if the controller cannot issue 4-byte OPCODE when booting.

config MTD_SPI_NOR_USE_4K_SECTORS
	bool "Use small 4096 B erase sectors"
	default n
	help
	  Many flash memories support erasing small (4096 B) sectors. Depending
	  on the usage this feature may provide performance gain in comparison
	  to erasing whole blocks (32/64 KiB).
	  Changing a small part of the flash's contents is usually faster with
	  small sectors. On the other hand erasing should be faster when using
	  64 KiB block instead of 16 × 4 KiB sectors.

	  Please note that some tools/drivers/filesystems may not work with
	  4096 B erase size (e.g. UBIFS requires 15 KiB as a minimum).

endif # MTD_SPI_NOR_IPROC
```

## kernel/linux-4.4/drivers/net/ethernet/broadcom/gmac/hnd/Kconfig
```kconfig
#
# Broadcom Home Networking Division (HND) driver configuration
#
# Copyright (C) 2013, Broadcom Corporation. All Rights Reserved.
# 
# Permission to use, copy, modify, and/or distribute this software for any
# purpose with or without fee is hereby granted, provided that the above
# copyright notice and this permission notice appear in all copies.
# 
# THE SOFTWARE IS PROVIDED "AS IS" AND THE AUTHOR DISCLAIMS ALL WARRANTIES
# WITH REGARD TO THIS SOFTWARE INCLUDING ALL IMPLIED WARRANTIES OF
# MERCHANTABILITY AND FITNESS. IN NO EVENT SHALL THE AUTHOR BE LIABLE FOR ANY
# SPECIAL, DIRECT, INDIRECT, OR CONSEQUENTIAL DAMAGES OR ANY DAMAGES
# WHATSOEVER RESULTING FROM LOSS OF USE, DATA OR PROFITS, WHETHER IN AN ACTION
# OF CONTRACT, NEGLIGENCE OR OTHER TORTIOUS ACTION, ARISING OUT OF OR IN
# CONNECTION WITH THE USE OR PERFORMANCE OF THIS SOFTWARE.
#

menu "Broadcom HND network devices"
# Kenlo	depends on PCI
config HND
	bool "Broadcom HND network device support"
	depends on GMAC_XGS_IPROC
config ET
	tristate "10/100 Ethernet support"
	depends on HND
choice
	prompt "ET ALL PASSIVE mode"
	depends on ET
	optional
config ET_ALL_PASSIVE_ON
	bool "ET ALL PASSIVE on"
config ET_ALL_PASSIVE_RUNTIME
	bool "ET ALL PASSIVE with runtime setting"
endchoice
config ET_NAPI2_POLL
	bool "BCM GMAC NAPI2_POLL"
	default n
	depends on !ET_ALL_PASSIVE_ON && !ET_ALL_PASSIVE_RUNTIME 
config BCM_IPROC_GMAC_ACP
	tristate "BCM GMAC_ACP support"
	depends on HND
	default n
	help
	  Add GMAC_ACP support to improve performance without 
	  cache flushing/invalidate. The uboot's bootargs must 
	  include "mem=240M" to limit whole Kernel memory inside 
	  ACP region which is 256MB from 0x80000000; since kernel 
	  starts from 0x81000000, total mem is 240MB only
	  If unsure, say N.
config BCM_IPROC_GMAC_PREFETCH
	tristate "BCM GMAC prefetching support"
	depends on HND
	default n
	help
	  If unsure, say N.
config BCM_IPROC_GMAC_TXONCPU1
	tristate "BCM GMAC TX-ON-CPU1 support"
	depends on HND && SMP && (ET_ALL_PASSIVE_ON || ET_ALL_PASSIVE_RUNTIME)
	default n
	help
	  Run "Passive Mode" Tx workthread on CPU1 for 
	  multi-cores utilizing;
	  If unsure, say N.
config BCM_IPROC_GMAC_LOCK_OPT
	tristate "BCM GMAC LOCK OPTIMIZATION support"
	depends on HND
	default n
	help
	  Minimize locks during Tx/Rx tasks;
	  it is tested under "Passive Mode" (workthread) only.
	  If unsure, say N.
config BCM_IPROC_GMAC_RWREG_OPT
	tristate "BCM GMAC R/W_REG OPTIMIZATION support"
	depends on HND
	default n
	help
	  Remove unnecessary "DSB" intructions of R/W_REG Macro.
	  If unsure, say N.
config BCM_IPROC_GMAC_SG
	bool "BCM GMAC Scatter Gather support"
	default n
	depends on HND
config IPROC_SDK_MGT_PORT_HANDOFF
	bool "GMAC SDK Management port handoff"
	default y
	depends on HND
config IPROC_2STAGE_RX
	bool "GMAC 2 stage packet RX"
	default n
	depends on HND
config SERDES_ASYMMETRIC_MODE
	bool "GMAC SDK Serdes Asymmetric Mode"
	default n
	depends on HND && (MACH_KT2 || MACH_HX4)
config JUMBO_FRAME
	bool "GMAC Jumbo Frame Support"
	default n
	depends on HND
endmenu
```

## u-boot-2016.01/board/broadcom/bcmkt2/Kconfig
```kconfig
if TARGET_BCMKT2

config SYS_BOARD
	default "bcmkt2"

config SYS_VENDOR
	default "broadcom"

config SYS_SOC
	default "bcmkt2"

config SYS_CONFIG_NAME
	default "bcm_katana2"

endif
```

## u-boot-2016.01/configs/bcm953416k_nand_defconfig
```kconfig
CONFIG_ARM=y
CONFIG_TARGET_BCMGH=y
CONFIG_LOCALVERSION="'-Broadcom XLDK-3.8.1'"
CONFIG_SYS_EXTRA_OPTIONS="IPROC_DDR_ECC,NAND_IPROC_BOOT"
# CONFIG_CMD_IMLS is not set
# CONFIG_CMD_FLASH is not set
# CONFIG_CMD_SETEXPR is not set
CONFIG_SYS_NS16550=y
CONFIG_SYS_PROMPT="u-boot> "
```

## u-boot-2016.01/configs/bcm956150k_nor_defconfig
```kconfig
CONFIG_ARM=y
CONFIG_TARGET_BCMHR2=y
CONFIG_LOCALVERSION="'-Broadcom XLDK-3.8.1'"
CONFIG_SYS_EXTRA_OPTIONS="NOR_IPROC_BOOT"
# CONFIG_CMD_IMLS is not set
# CONFIG_CMD_FLASH is not set
# CONFIG_CMD_SETEXPR is not set
CONFIG_SYS_NS16550=y
CONFIG_SYS_PROMPT="u-boot> "
```

## u-boot-2016.01/configs/bcm956340k_defconfig
```kconfig
CONFIG_ARM=y
CONFIG_TARGET_BCMHX4=y
CONFIG_LOCALVERSION="'-Broadcom XLDK-3.8.1'"
CONFIG_SYS_EXTRA_OPTIONS="IPROC_DDR_ECC"
# CONFIG_CMD_IMLS is not set
# CONFIG_CMD_FLASH is not set
# CONFIG_CMD_SETEXPR is not set
CONFIG_SYS_NS16550=y
CONFIG_SYS_PROMPT="u-boot> "
```
